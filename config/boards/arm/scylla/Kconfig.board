## config/boards/arm/scylla/Kconfig.board
```kconfig
# Copyright (c) 2020-2021 Thys de Wet (vattern)
# SPDX-License-Identifier: MIT



config BOARD_SCYLLA_LEFT
	bool "scylla_left"
	depends on SOC_NRF52840_QIAA

config BOARD_SCYLLA_RIGHT
	bool "scylla_right"
	depends on SOC_NRF52840_QIAA
```

## config/boards/arm/scylla/Kconfig.defconfig
```kconfig
# Copyright (c) 2020-2021 Thys de Wet (vattern)
# SPDX-License-Identifier: MIT

if BOARD_SCYLLA_LEFT

config ZMK_SPLIT_ROLE_CENTRAL
	default y

config ZMK_KEYBOARD_NAME
	default "BastardKB Scylla"

endif # BOARD_SCYLLA_LEFT

if BOARD_SCYLLA_RIGHT

	config ZMK_KEYBOARD_NAME
	default "Scylla rt"

endif # BOARD_SCYLLA_RIGHT


if BOARD_SCYLLA_LEFT || BOARD_SCYLLA_RIGHT

config BOARD
	default "scylla"

config ZMK_SPLIT
	default y

config SPI
    bool
    default y

config SPI
    bool
    default y

config BT_CTLR
	default BT

config ZMK_BLE
	default y

config ZMK_USB
	default y        

if USB

config USB_NRFX
	default y

config USB_DEVICE_STACK
	default y

endif # USB

config ZMK_BATTERY_VOLTAGE_DIVIDER
	default y

config SPI
	default y


endif # BOARD_SCYLLA_LEFT || BOARD_SCYLLA_RIGHT
```
